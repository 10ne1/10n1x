## layers/meta-10n1x/conf/bblayers.conf.sample
```bitbake
LCONF_VERSION = "7"

BBPATH = "${TOPDIR}"
BBFILES ?= ""

BBLAYERS ?= " \
	${TOPDIR}/../layers/openembedded-core/meta \
	${TOPDIR}/../layers/meta-openembedded/meta-oe \
	${TOPDIR}/../layers/meta-openembedded/meta-python \
	${TOPDIR}/../layers/meta-openembedded/meta-multimedia \
	${TOPDIR}/../layers/meta-openembedded/meta-networking \
	${TOPDIR}/../layers/meta-openembedded/meta-filesystems \
	${TOPDIR}/../layers/meta-raspberrypi \
	${TOPDIR}/../layers/meta-10n1x \
"
```

## layers/meta-10n1x/conf/distro/10n1x.conf
```bitbake
DISTRO = "10n1x"
DISTRO_NAME = "10ne1's distro"
DISTRO_VERSION = "1.0"

DISTRO_FEATURES = "acl alsa usbhost wifi xattr largefile pam ipv4 ipv6 usrmerge libtool x11 wayland opengl systemd"

MACHINE_FEATURES_BACKFILL_CONSIDERED = "gobject-introspection-data"
DISTRO_FEATURES_BACKFILL_CONSIDERED = "gobject-introspection-data sysvinit pulseaudio bluez5"

PREFERRED_PROVIDER_virtual/kernel = "linux-10n1x"

PREFERRED_VERSION_sox = "git"

VIRTUAL-RUNTIME_init_manager = "systemd"
VIRTUAL-RUNTIME_initscripts = "systemd-compat-units"

ENABLE_BINARY_LOCALE_GENERATION = "0"

GTKDOC_ENABLED = "False"

INHIBIT_UPDATERCD_BBCLASS = "1"

KERNEL_DEVICETREE_raspberrypi3 = "\
	bcm2837-rpi-3-b.dtb \
"

USER = "adi"

# needed by sox & ffmpeg
LICENSE_FLAGS_WHITELIST = "commercial"

PRSERV_HOST = "localhost:0"
INHERIT += "buildhistory"
BUILDHISTORY_COMMIT = "1"
```

## layers/meta-10n1x/conf/local.conf.sample
```bitbake
CONF_VERSION = "1"

DISTRO = "10n1x"

PACKAGE_CLASSES = "package_ipk"

MACHINE ??= "raspberrypi3"

INHERIT += "rm_work"

USER_CLASSES ?= "image-mklibs image-prelink"

PATCHRESOLVE = "noop"

#
# Disk Space Monitoring during the build
#
# Monitor the disk space during the build. If there is less that 1GB of space or less
# than 100K inodes in any key build location (TMPDIR, DL_DIR, SSTATE_DIR), gracefully
# shutdown the build. If there is less that 100MB or 1K inodes, perform a hard abort
# of the build. The reason for this is that running completely out of space can corrupt
# files and damages the build in ways which may not be easily recoverable.
# It's necesary to monitor /tmp, if there is no space left the build will fail
# with very exotic errors.
BB_DISKMON_DIRS ??= "\
    STOPTASKS,${TMPDIR},1G,100K \
    STOPTASKS,${DL_DIR},1G,100K \
    STOPTASKS,${SSTATE_DIR},1G,100K \
    STOPTASKS,/tmp,100M,100K \
    ABORT,${TMPDIR},100M,1K \
    ABORT,${DL_DIR},100M,1K \
    ABORT,${SSTATE_DIR},100M,1K \
    ABORT,/tmp,10M,1K"
```

## layers/meta-10n1x/conf/machine/mips.conf
```bitbake
DEFAULTTUNE ?= "mips32r2-24kc"
require conf/machine/include/mips/tune-mips-24k.inc
```

## layers/meta-10n1x/conf/machine/x64.conf
```bitbake
DEFAULTTUNE ?= "core2-64"
require conf/machine/include/tune-core2.inc
require conf/machine/include/x86-base.inc
```

## meta/conf/bblayers.conf.sample
```bitbake
LCONF_VERSION = "7"

BBPATH = "${TOPDIR}"
BBFILES ?= ""

ROOT = "${@os.path.abspath(os.path.join("${TOPDIR}", os.pardir))}"

BBLAYERS ?= " \
	${ROOT}/layers/openembedded-core/meta \
	${ROOT}/layers/meta-openembedded/meta-oe \
	${ROOT}/layers/meta-openembedded/meta-python \
	${ROOT}/layers/meta-openembedded/meta-multimedia \
	${ROOT}/layers/meta-openembedded/meta-networking \
	${ROOT}/layers/meta-openembedded/meta-filesystems \
	${ROOT}/layers/meta-raspberrypi \
	${ROOT}/meta \
"
```

## meta/conf/distro/10n1x.conf
```bitbake
DISTRO = "10n1x"
DISTRO_NAME = "10ne1's distro"
DISTRO_VERSION = "1.0"

DISTRO_FEATURES = "acl alsa usbhost wifi systemd xattr largefile pam ${DISTRO_FEATURES_LIBC}"
DISTRO_FEATURES_BACKFILL_CONSIDERED += "sysvinit"

VIRTUAL-RUNTIME_init_manager = "systemd"
VIRTUAL-RUNTIME_initscripts = "systemd-compat-units"

PREFERRED_PROVIDER_virtual/kernel = "linux-ionel"

TCLIBC = "musl"

IONEL_USER = "adi"

KERNEL_DEVICETREE_raspberrypi3 = "\
	bcm2837-rpi-3-b.dtb \
"

# needed by sox & ffmpeg
LICENSE_FLAGS_WHITELIST = "commercial"
```

## meta/conf/distro/ionel-distro.conf
```bitbake
DISTRO = "ionel-distro"
DISTRO_NAME = "Ionel's distro"
DISTRO_VERSION = "0.1"

DISTRO_FEATURES = "acl alsa usbhost wifi systemd xattr largefile pam ${DISTRO_FEATURES_LIBC}"
DISTRO_FEATURES_BACKFILL_CONSIDERED += "sysvinit"

VIRTUAL-RUNTIME_init_manager = "systemd"
VIRTUAL-RUNTIME_initscripts = "systemd-compat-units"

PREFERRED_PROVIDER_virtual/kernel = "linux-ionel"

TCLIBC = "musl"

IONEL_USER = "adi"

KERNEL_DEVICETREE_raspberrypi3 = "\
	bcm2837-rpi-3-b.dtb \
"

# needed by sox & ffmpeg
LICENSE_FLAGS_WHITELIST = "commercial"
```
